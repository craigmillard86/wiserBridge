## main/Kconfig.projbuild
```kconfig
menu "WiserBridge Router"

    menu "Device identity (compatibility profile defaults)"
        comment "Defaults are deliberately generic. Do NOT enter Drayton/Wiser values unless captured from real evidence (see fingerprints/)."

        config WB_MANUFACTURER_NAME
            string "Basic cluster ManufacturerName (max 32 chars)"
            default "DIY-ESP32C6"

        config WB_MODEL_IDENTIFIER
            string "Basic cluster ModelIdentifier (max 32 chars)"
            default "ZB-ROUTER-C6"

        config WB_ENDPOINT
            int "Application endpoint number"
            range 1 240
            default 1

        config WB_PROFILE_ID
            hex "Application profile ID"
            default 0x0104
            help
                0x0104 = Zigbee Home Automation (used by Zigbee 3.0 devices).

        config WB_DEVICE_ID
            hex "Application device ID"
            default 0x0008
            help
                0x0008 = HA Range Extender.

        config WB_DEVICE_VERSION
            int "Application device version"
            range 0 15
            default 0

        config WB_NODE_MANUFACTURER_CODE
            hex "Node descriptor manufacturer code (0 = keep SDK default)"
            default 0x0000
            range 0x0000 0xFFFF

        config WB_ENABLE_IDENTIFY
            bool "Expose Identify server cluster"
            default y
    endmenu

    menu "Zigbee network"
        config WB_MAX_CHILDREN
            int "Maximum child devices (end devices) this router accepts"
            range 1 32
            default 20
            help
                Upper bound of 32 is the ZBOSS default nib.max_children. The child
                table shares the neighbour table, sized by WB_NETWORK_SIZE.
                Configuring N slots does NOT guarantee N TRVs will choose this router.

        config WB_NETWORK_SIZE
            int "Overall network size (sizes neighbour/routing/address tables)"
            range 32 128
            default 64

        config WB_CHANNEL_MASK
            hex "Channel mask searched when joining"
            default 0x07FFF800
            help
                Bit N = channel N. 0x07FFF800 = channels 11..26. Narrow this to the
                Wiser channel once known to avoid joining a different network.

        config WB_TCLK_EXCHANGE_REQUIRED
            bool "Require Trust Center link key exchange (Zigbee 3.0 behaviour)"
            default y
            help
                Disable only if evidence shows the hub is a pre-R21 (legacy) trust
                centre and joins fail with TCLK_EX_FAILURE. Runtime override: "tclk".

        config WB_TX_POWER_DBM
            int "802.15.4 TX power (dBm)"
            range -24 20
            default 18
            help
                Keep total EIRP within your local regulatory limit (EU/UK 2.4 GHz:
                20 dBm EIRP). Account for any external antenna gain.

        config WB_STEERING_WINDOW_S
            int "Join attempt window after a join request (seconds)"
            range 30 900
            default 180

        config WB_STEERING_RETRY_S
            int "Delay between join attempts inside the window (seconds)"
            range 5 120
            default 15

        config WB_AUTO_JOIN_ON_FIRST_BOOT
            bool "Start joining automatically when factory-new"
            default n
            help
                Off by default so the device never joins a neighbour's open network by
                accident. Use the "join" command or a short BOOT press instead.

        config WB_ISOLATION_ALERT_S
            int "Warn if joined but no router neighbours for this long (seconds)"
            range 60 86400
            default 900
    endmenu

    menu "Diagnostics"
        config WB_HEALTH_INTERVAL_S
            int "Periodic HEALTH line interval (seconds, 0 = off)"
            range 0 86400
            default 300
    endmenu

    menu "Board (Seeed XIAO ESP32-C6)"
        config WB_RF_SWITCH_EN_GPIO
            int "RF switch enable GPIO (driven LOW to enable), -1 = none"
            range -1 30
            default 3

        config WB_ANT_SELECT_GPIO
            int "Antenna select GPIO, -1 = none"
            range -1 30
            default 14

        config WB_ANTENNA_EXTERNAL
            bool "Use external U.FL antenna (antenna select HIGH)"
            default n

        config WB_LED_GPIO
            int "Status LED GPIO, -1 = none"
            range -1 30
            default 15

        config WB_LED_ACTIVE_LOW
            bool "Status LED is active-low"
            default y

        config WB_BUTTON_GPIO
            int "Button GPIO (BOOT), -1 = none"
            range -1 30
            default 9

        config WB_FACTORY_RESET_HOLD_S
            int "Hold button this long to request network reset (seconds)"
            range 5 30
            default 10
    endmenu

endmenu
```

## sniffer/sdkconfig.defaults
```kconfig
CONFIG_IDF_TARGET="esp32c6"
CONFIG_ESPTOOLPY_FLASHSIZE_4MB=y
CONFIG_ESP_CONSOLE_USB_SERIAL_JTAG=y
CONFIG_IEEE802154_ENABLED=y
CONFIG_BT_ENABLED=n
CONFIG_BOOTLOADER_LOG_LEVEL_WARN=y
CONFIG_LOG_DEFAULT_LEVEL_WARN=y
CONFIG_FREERTOS_HZ=1000
```
